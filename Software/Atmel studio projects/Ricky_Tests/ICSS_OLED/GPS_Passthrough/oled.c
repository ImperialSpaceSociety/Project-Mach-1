// OLED SSD1315 for Seeed Grove OLED using the I2C interface
// 

#include "atmel_start.h"
#include "atmel_start_pins.h"
#include "OLED.h"

// 8x8 Font ASCII 32 - 127 Implemented
// Users can modify this to support more characters(glyphs)
// BasicFont is placed in code memory.

// This font be freely used without any restriction(It is placed in public domain)
const unsigned char BasicFont[][8] =
{
  {0x00,0x00,0x00,0x00,0x00,0x00,0x00,0x00},
  {0x00,0x00,0x5F,0x00,0x00,0x00,0x00,0x00},
  {0x00,0x00,0x07,0x00,0x07,0x00,0x00,0x00},
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  {0x00,0x02,0x05,0x05,0x02,0x00,0x00,0x00}
};


// Initialisation string for SSD1306 OLED display
uint8_t initbuf[]={0x00,0xae,0xa8,0x3f,0xd3,0x00,0x40,0xa1,0xc8,
	0xda,0x12,0x81,0xff,0xa4,0xa6,0xd5,0x80,0x8d,0x14,
0xaf,0x20,0x02};


static unsigned char addressingMode;
struct _i2c_m_msg msg;


void oled_Init(void)

{
    // Send Initialsation string
	msg.addr   = SeeedOLED_Address;
    msg.len    = sizeof(initbuf);
    msg.flags  = I2C_M_STOP;
    msg.buffer = &initbuf[0];
	i2c_m_sync_transfer(&I2C_1, &msg);
   
	
	delay_ms(100);
	oled_SendCommand(SeeedOLED_Display_Off_Cmd);     //display off
    delay_ms(5);
    oled_SendCommand(SeeedOLED_Display_On_Cmd);  //display on
    delay_ms(5);
    oled_SendCommand(SeeedOLED_Normal_Display_Cmd);  //Set Normal Display (default)
}

void oled_SendCommand(unsigned char command)
{
	uint8_t command_bytes[2];
	command_bytes[0] = 0x00;
	command_bytes[1] = command;
	msg.len = 2;
	msg.buffer = &command_bytes[0];
	i2c_m_sync_transfer(&I2C_1, &msg);
}

void oled_Send_2_Command(unsigned char command1, unsigned char command2)
{
	uint8_t command_bytes[3];
	command_bytes[0] = 0x00;
	command_bytes[1] = command1;
	command_bytes[2] = command2;
	msg.len = 3;
	msg.buffer = &command_bytes[0];
	i2c_m_sync_transfer(&I2C_1, &msg);
}

void oled_SetBrightness(unsigned char Brightness)
{
   oled_SendCommand(SeeedOLED_Set_Brightness_Cmd);
   oled_SendCommand(Brightness);
}

void oled_SetHorizontalMode()
{
    addressingMode = HORIZONTAL_MODE;
	
    oled_Send_2_Command(0x20, 0x00);     //set horizontal addressing mode
}

void oled_SetPageMode()
{
    addressingMode = PAGE_MODE;
    oled_Send_2_Command(0x20, 0x02);     //set page addressing mode
}


void oled_SetTextXY(unsigned char Row, unsigned char Column)
{
    oled_SendCommand(0xB0 + Row);            //set page address
    oled_SendCommand(0x00 + (8*Column & 0x0F));  //set column lower address
    oled_SendCommand(0x10 + ((8*Column>>4)&0x0F));   //set column higher address
}


void oled_ClearDisplay()
{
  unsigned char i,j;
  oled_SendCommand(SeeedOLED_Display_Off_Cmd);   //display off
  for(j=0;j<8;j++)
  {
    oled_SetTextXY(j,0);
    {
      for(i=0;i<16;i++)  //clear all columns
      {
        oled_PutChar(' ');
      }
    }
  }
  oled_SendCommand(SeeedOLED_Display_On_Cmd);    //display on
  oled_SetTextXY(0,0);
}

void oled_SendData(unsigned char data)
{
	 uint8_t data_bytes[2];
	 data_bytes[0] = 0x40;
	 data_bytes[1] = data;
	 msg.len = 2;
	 msg.buffer = &data_bytes[0];
	 i2c_m_sync_transfer(&I2C_1, &msg);
	 
	
	 
	 
}

void oled_PutChar(unsigned char C)
{
    if(C < 32 || C > 127) //Ignore non-printable ASCII characters. This can be modified for multilingual font.
    {
    C=' '; //Space
    }
    unsigned char i=0;
    for(i=0;i<8;i++)
    {
       //read bytes from code memory
       oled_SendData(BasicFont[C-32][i]); //font array starts at 0, ASCII starts at 32. Hence the translation
    }
}

void oled_PutString(const char *String)
{
    unsigned char i=0;
    while(String[i])
    {
        oled_PutChar(String[i]);
        i++;
    }
}

unsigned char oled_PutNumber(long long_num)
{
  unsigned char char_buffer[10]="";
  unsigned char i = 0;
  unsigned char f = 0;

  if (long_num < 0)
  {
    f=1;
    oled_PutChar('-');
    long_num = -long_num;
  }
  else if (long_num == 0)
  {
    f=1;
    oled_PutChar('0');
    return f;
  }

  while (long_num > 0)
  {
    char_buffer[i++] = long_num % 10;
    long_num /= 10;
  }

  f=f+i;
  for(; i > 0; i--)
  {
    oled_PutChar('0'+ char_buffer[i - 1]);
  }
  return f;

}

unsigned char oled_PutFloatn(float floatNumber,unsigned char decimal)
{
  unsigned int temp=0;
  float decy=0.0;
  float rounding = 0.5;
  unsigned char f=0;
  if(floatNumber<0.0)
  {
    oled_PutString("-");
    floatNumber = -floatNumber;
    f +=1;
  }
  for (unsigned char i=0; i<decimal; ++i)
  {
    rounding /= 10.0;
  }
    floatNumber += rounding;
  
  temp = floatNumber;
  f += oled_PutNumber(temp);
  if(decimal>0)
  {
    oled_PutChar('.');
    f +=1;
 }
  decy = floatNumber-temp;//decimal part,
  for(unsigned char i=0;i<decimal;i++)//4
  {
    decy *=10;// for the next decimal
    temp = decy;//get the decimal
    oled_PutNumber(temp);
    decy -= temp;
  }
  f +=decimal;
  return f;
}
unsigned char oled_PutFloat(float floatNumber)
{
  unsigned char decimal=2;
  unsigned int temp=0;
  float decy=0.0;
  float rounding = 0.5;
  unsigned char f=0;
  if(floatNumber<0.0)
  {
    oled_PutString("-");
    floatNumber = -floatNumber;
    f +=1;
  }
  for (unsigned char i=0; i<decimal; ++i)
  {
    rounding /= 10.0;
  }
    floatNumber += rounding;
  
  temp = floatNumber;
  f += oled_PutNumber(temp);
  if(decimal>0)
  {
    oled_PutChar('.');
    f +=1;
 }
  decy = floatNumber-temp;//decimal part,
  for(unsigned char i=0;i<decimal;i++)//4
  {
    decy *=10;// for the next decimal
    temp = decy;//get the decimal
    oled_PutNumber(temp);
    decy -= temp;
  }
  f +=decimal;
  return f;
}

void oled_DrawBitmap(unsigned char *bitmaparray,int pages)
{
  char localAddressMode = addressingMode;
  uint8_t display_char;
  uint8_t shift_in_bit, shift_out_bit;
  uint8_t page, block,column, bit;
  
  if(addressingMode != HORIZONTAL_MODE)
   
  {
      //Bitmap is drawn in horizontal mode
      oled_SetHorizontalMode();
	 
	  
  }

  for(page=0; page < pages; page++)
  {
	   oled_SetTextXY(page , 0);
	   for(block=0; block < 16; block++){
		   shift_in_bit = 1;
		   for(column=0; column < 8; column++){
			   display_char = 0x00;			  
			   shift_out_bit = 0x01;
			   for(bit=0; bit < 8; bit++){
				   if((bitmaparray[((page * 128) + (bit * 16) + block)] & shift_in_bit) != 0) display_char |= shift_out_bit;
				   
				   shift_out_bit <<= 1;
			   }
			   oled_SendData(display_char);
			    shift_in_bit <<= 1;
		   }
		  
		   
	   }
	  
  }

  if(localAddressMode == PAGE_MODE)
  {
     //If pageMode was used earlier, restore it.
     oled_SetPageMode();
  }
  
}

void oled_SetHorizontalScrollProperties(unsigned char direction, unsigned char startPage, unsigned char endPage, unsigned char scrollSpeed)
{
/*
Use the following defines for 'direction' :

 Scroll_Left
 Scroll_Right

Use the following defines for 'scrollSpeed' :

 Scroll_2Frames
 Scroll_3Frames
 Scroll_4Frames
 Scroll_5Frames
 Scroll_25Frames
 Scroll_64Frames
 Scroll_128Frames
 Scroll_256Frames

*/

   if(Scroll_Right == direction)
   {
        //Scroll Right
        oled_SendCommand(0x26);
   }
   else
   {
        //Scroll Left
        oled_SendCommand(0x27);

   }
    oled_SendCommand(0x00);
    oled_SendCommand(startPage);
    oled_SendCommand(scrollSpeed);
    oled_SendCommand(endPage);
    oled_SendCommand(0x00);
    oled_SendCommand(0xFF);
}

void oled_ActivateScroll()
{
    oled_SendCommand(SeeedOLED_Activate_Scroll_Cmd);
}

void oled_DeactivateScroll()
{
    oled_SendCommand(SeeedOLED_Dectivate_Scroll_Cmd);
}

void oled_SetNormalDisplay()
{
    oled_SendCommand(SeeedOLED_Normal_Display_Cmd);
}

void oled_SetInverseDisplay()
{
    oled_SendCommand(SeeedOLED_Inverse_Display_Cmd);
}


